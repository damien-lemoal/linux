// SPDX-License-Identifier: (GPL-2.0+ OR MIT)
/*
 * DT-overlay to run the PCIe3_4L Dual Mode controller in Endpoint mode
 * in the SRNS (Separate Reference Clock No Spread) configuration.
 *
 * NOTE: If using a setup with two ROCK 5B:s, with one board running in
 * RC mode and the other board running in EP mode, see also the device
 * tree overlay: rk3588-rock-5b-pcie-srns.dtso.
 */

/dts-v1/;
/plugin/;

&pcie3x4_ep {
	num-lanes = <1>;
};
