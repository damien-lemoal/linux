## Documentation/devicetree/bindings/clock/kendryte,k210-clk.yaml
```yaml
# SPDX-License-Identifier: (GPL-2.0-only OR BSD-2-Clause)
%YAML 1.2
---
$id: http://devicetree.org/schemas/clock/kendryte,k210-clk.yaml#
$schema: http://devicetree.org/meta-schemas/core.yaml#

title: Kendryte K210 Clock Device Tree Bindings

maintainers:
  - Damien Le Moal <damien.lemoal@wdc.com>

description: |
  Kendryte K210 clock controller driver which support the system controller
  subsystem supplied clocks for the various controllers and peripherals within
  the SoC.

  See also:
  - dt-bindings/clock/k210-clk.h

properties:
  compatible:
    const: kendryte,k210-clk

  clocks:
    maxItems: 1
    description: System fixed rate oscillator clock

  '#clock-cells':
    const: 1

required:
  - compatible
  - '#clock-cells'
  - clocks

additionalProperties: false

examples:
  - |
    #include <dt-bindings/clock/k210-clk.h>

    clocks {
      in0: oscillator {
        compatible = "fixed-clock";
        #clock-cells = <0>;
        clock-frequency = <26000000>;
      };
    };

    soc {
      #address-cells = <1>;
      #size-cells = <1>;
      /* ... */

      sysctl: system-controller@50440000 {
        #address-cells = <1>;
        #size-cells = <1>;
        compatible = "kendryte,k210-sysctl",
                     "syscon", "simple-mfd";
        reg = <0x50440000 0x1000>;
        /* ... */
        sysclk: clock-controller {
          #clock-cells = <1>;
          compatible = "kendryte,k210-clk";
          clocks = <&in0>;
        };
        /* ... */
      };
    };
```

## Documentation/devicetree/bindings/clock/kendryte,k210-sysclk.txt
```
* Kendryte K210 Clock Controller

The Kendryte K210 system controller subsystem generates and supplies clock to
various controllers within the K210 SoC.

Required Properties:

- compatible: must be "kendryte,k210-sysclk"
- #clock-cells: must be 1
- clocks: node of the base external fixed-rate oscillator
- clock-names: must be "in0"

The K210 clock controller node must be defined as a child node of the SoC
system controller ("kendryte,k210-sysctl" compatible). The register space for
the clock controller is obtained from the system controller parent node.

Each clock is assigned an identifier and client nodes use this identifier
to specify the clock which they consume. All clock identifiers can be found
in <dt-bindings/clock/k210-sysctl.h>.

Example:

	clocks {
		in0: oscillator {
			compatible = "fixed-clock";
			#clock-cells = <0>;
			clock-frequency = <26000000>;
		};
	};

	soc {
		...

		sysctl: system-controller@50440000 {
			#address-cells = <1>;
			#size-cells = <1>;
			compatible = "kendryte,k210-sysctl",
			     	"syscon", "simple-mfd";
			reg = <0x50440000 0x1000>;
			...

			sysclk: clock-controller {
				#clock-cells = <1>;
				compatible = "kendryte,k210-sysclk";
				clocks = <&in0>;
				clock-names ="in0";
			};
		};
		...
	};
```

## Documentation/devicetree/bindings/mfd/kendryte,k210-sysctl.yaml
```yaml
# SPDX-License-Identifier: (GPL-2.0-only OR BSD-2-Clause)
%YAML 1.2
---
$id: http://devicetree.org/schemas/mfd/kendryte,k210-sysctl.yaml#
$schema: http://devicetree.org/meta-schemas/core.yaml#

title: Kendryte K210 System Controller Device Tree Bindings

maintainers:
  - Damien Le Moal <damien.lemoal@wdc.com>

description: |
  Kendryte K210 system controller driver which provides a register map for
  clocks and peripherals within the SoC.

  See also:
  - dt-bindings/mfd/kendryte,k210-sysctl.h

properties:
  compatible:
    allOf:
      - items:
        - const: kendryte,k210-sysctl
        - const: syscon
        - const: simple-mfd

  clocks:
    minItems: 1
    maxItems: 1
    items:
      - description: APB interface clock source

  clock-names:
    minItems: 1
    items:
      - const: pclk

  reg:
    items:
      - description: system controller register space base address and size

  reg-io-width:
    const: 4

required:
  - compatible
  - clocks
  - reg

additionalProperties: false

examples:
  - |
    #include <dt-bindings/mfd/k210-sysctl.h>

    sysctl: system-controller@50440000 {
      #address-cells = <1>;
      #size-cells = <1>;
      compatible = "kendryte,k210-sysctl",
                   "syscon", "simple-mfd";
      reg = <0x50440000 0x1000>;
      reg-io-width = <4>;
      /* ... */
    };
```

## Documentation/devicetree/bindings/pinctrl/kendryte,k210-fpioa.yaml
```yaml
# SPDX-License-Identifier: (GPL-2.0-only OR BSD-2-Clause)
%YAML 1.2
---
$id: http://devicetree.org/schemas/pinctrl/kendryte,k210-fpioa.yaml#
$schema: http://devicetree.org/meta-schemas/core.yaml#

title: Kendryte K210 FPIOA (Fully Programmable IO Array) Device Tree Bindings

maintainers:
  - Damien Le Moal <damien.lemoal@wdc.com>

description:
  The Kendryte K210 SoC Fully Programmable IO Array controller allows assiging
  any of 256 possible functions to any of 48 IO pins. Pin function configuration
  is performed on a per-pin basis.

properties:
  compatible:
    const: kendryte,k210-fpioa

  reg:
    description: FPIOA controller register space base address and size

  clocks:
    minItems: 2
    maxItems: 2
    items:
      - description: Controller reference clock source
      - description: APB interface clock source

  clock-names:
    minItems: 2
    maxItems: 2
    items:
      - const: ref
      - const: pclk

  resets:
    maxItems: 1

  kendryte,sysctl:
    minItems: 1
    maxItems: 1
    $ref: /schemas/types.yaml#/definitions/phandle-array
    description: |
      phandle to the system controller node

  kendryte,power-offset:
    minItems: 1
    maxItems: 1
    $ref: /schemas/types.yaml#/definitions/uint32
    description: |
      Offset of the power domain control register of the system controller.
      The value should be the macro K210_SYSCTL_POWER_SEL defined in
      dt-bindings/mfd/k210-sysctl.h.

patternProperties:
  '^.*$':
    if:
      type: object
    then:
      patternProperties:
        "^pinmux$":
          $ref: /schemas/pinctrl/pincfg-node.yaml
          description:
            An array of IO pins alternate functions. The values for each
            IO pin is a combination of an IO pin number (0 to 47) with the
            desired function for the IO pin. Functions are defined as macros in
            dt-bindings/pinctrl/k210-pinctrl.h. The K210_FPIOA(IO pin, function)
            is provided to facilitate the combination of IO pin numbers and
            functions.

required:
  - compatible
  - reg
  - clocks
  - resets
  - kendryte,sysctl
  - kendryte,power-offset

additionalProperties: false

examples:
  - |
    #include <dt-bindings/pinctrl/k210-pinctrl.h>
    #include <dt-bindings/mfd/k210-sysctl.h>
    #include <dt-bindings/clock/k210-sysctl.h>
    #include <dt-bindings/reset/k210-sysctl.h>

    fpioa: pinmux@502B0000 {
      compatible = "kendryte,k210-fpioa";
      reg = <0x502B0000 0x100>;
      clocks = <&sysclk K210_CLK_FPIOA>;
      resets = <&sysrst K210_RST_FPIOA>;
      kendryte,sysctl = <&sysctl>;
      kendryte,power-offset = <K210_SYSCTL_POWER_SEL>;
      pinctrl-0 = <&fpioa_jtag>;
      pinctrl-names = "default";

      fpioa_jtag: jtag {
        pinmux = <K210_FPIOA(0, K210_PCF_JTAG_TCLK)>,
                 <K210_FPIOA(1, K210_PCF_JTAG_TDI)>,
                 <K210_FPIOA(2, K210_PCF_JTAG_TMS)>,
                 <K210_FPIOA(3, K210_PCF_JTAG_TDO)>;
      };
    };
```

## Documentation/devicetree/bindings/reset/kendryte,k210-rst.yaml
```yaml
# SPDX-License-Identifier: (GPL-2.0-only OR BSD-2-Clause)
%YAML 1.2
---
$id: http://devicetree.org/schemas/reset/kendryte,k210-rst.yaml#
$schema: http://devicetree.org/meta-schemas/core.yaml#

title: Kendryte K210 Reset Controller Device Tree Bindings

maintainers:
  - Damien Le Moal <damien.lemoal@wdc.com>

description: |
  Kendryte K210 reset controller driver which support the system controller
  subsystem supplied reset registers for the various peripherals within
  the SoC.

  See also:
  - dt-bindings/reset/k210-rst.h

properties:
  compatible:
    allOf:
      - items:
        - const: kendryte,k210-rst
        - const: syscon-reset

  regmap:
    maxItems: 1
    description: phandle of the system controller (sysctl) node

  offset:
    maxItems: 1
    description: peripheral reset register offset in the system controller
      controller register map

  mask:
    maxItems: 1
    description: bit-mask indicating valid reset bits in the reset register

  assert-high:
    maxItems: 1
    description: bit value to write when asserting a reset

  '#reset-cells':
    const: 1

required:
  - '#reset-cells'
  - compatible
  - regmap
  - offset
  - mask
  - assert-high

additionalProperties: false

examples:
  - |
    #include <dt-bindings/mfd/k210-sysctl.h>
    #include <dt-bindings/reset/k210-rst.h>

    sysctl: system-controller@50440000 {
      #address-cells = <1>;
      #size-cells = <1>;
      compatible = "kendryte,k210-sysctl",
                   "syscon", "simple-mfd";
      reg = <0x50440000 0x1000>;
      /* ... */
      sysrst: reset-controller {
        compatible = "kendryte,k210-rst",
                      "syscon-reset";
        #reset-cells = <1>;
        regmap = <&sysctl>;
        offset = <K210_SYSCTL_PERI_RESET>;
        mask = <0x27FFFFFF>;
        assert-high = <1>;
      };
    };
```

## Documentation/devicetree/bindings/reset/kendryte,k210-sysrst.txt
```
Kendryte K210 Reset controller
==============================

Please also refer to reset.txt in this directory for common reset
controller binding usage.

Required properties:

- compatible: should be "kendryte,k210-sysrst"

- reg: physical base address of the reset controller and length of memory
       mapped region (4B).

- #reset-cells: must be 1.

example:

	sysctl: system-controller@50440000 {
		#address-cells = <1>;
		#size-cells = <1>;
		compatible = "kendryte,k210-sysctl",
			     "syscon", "simple-mfd";
		reg = <0x50440000 0x1000>;
        	ranges = <0 0x50440000 0x1000>;
		...

		sysrst: reset-controller {
			compatible = "kendryte,k210-sysrst";
			reg = <K210_SYSCTL_PERI_RESET 0x4>;
			#reset-cells = <1>;
		};
	};
```

## arch/riscv/Kconfig.socs
```kconfig
menu "SoC selection"

config SOC_SIFIVE
	bool "SiFive SoCs"
	select SERIAL_SIFIVE if TTY
	select SERIAL_SIFIVE_CONSOLE if TTY
	select CLK_SIFIVE
	select CLK_SIFIVE_FU540_PRCI
	select SIFIVE_PLIC
	help
	  This enables support for SiFive SoC platform hardware.

config SOC_VIRT
	bool "QEMU Virt Machine"
	select CLINT_TIMER if RISCV_M_MODE
	select POWER_RESET
	select POWER_RESET_SYSCON
	select POWER_RESET_SYSCON_POWEROFF
	select GOLDFISH
	select RTC_DRV_GOLDFISH if RTC_CLASS
	select SIFIVE_PLIC
	help
	  This enables support for QEMU Virt Machine.

config SOC_KENDRYTE
	bool "Kendryte K210 SoC"
	depends on !MMU
	select CLINT_TIMER if RISCV_M_MODE
	select SERIAL_SIFIVE if TTY
	select SERIAL_SIFIVE_CONSOLE if TTY
	select SIFIVE_PLIC
	select PM
	select SIMPLE_PM_BUS
	help
	  This enables support for Kendryte K210 SoC platform hardware.

config SOC_KENDRYTE_K210_DTB
	def_bool y
	depends on SOC_KENDRYTE && SOC_KENDRYTE_K210_DTB_BUILTIN

if SOC_KENDRYTE

config SOC_KENDRYTE_K210_DTB_BUILTIN
	bool "Builtin device tree for the Kendryte K210"
	depends on SOC_KENDRYTE
	default y
	select OF
	select BUILTIN_DTB
	select SOC_KENDRYTE_K210_DTB
	help
	  Build a device tree for the Kendryte K210 into the Linux image.
	  This option should be selected if no bootloader is being used.
	  If unsure, say Y.

config SOC_KENDRYTE_K210_DTB_SOURCE
	string "Source file for the Kendryte K210 builtin DTB"
	default "k210"
	depends on SOC_KENDRYTE_K210_DTB_BUILTIN
	help
	  Base name (without suffix, relative to arch/riscv/boot/dts/kendryte)
	  for the DTS file that will be used to produce the DTB linked into the
	  kernel.

config SOC_KENDRYTE_K210_CLK_DEBUG
	bool "Enable clock information debug print for the Kendryte K210"
	default n
	help
	  Enable clock information debug print on boot. Prints are enabled
	  by adding the boolean property "debug;" to the sysclk node of the
	  Kendryte K210 device tree (arch/riscv/boot/dts/kendryte/k210.dtsi).

endif

endmenu
```

## drivers/soc/canaan/Kconfig
```kconfig
# SPDX-License-Identifier: GPL-2.0

config SOC_K210_SYSCTL
	bool "Canaan Kendryte K210 SoC system controller"
	depends on RISCV && SOC_CANAAN && OF
        select PM
        select SIMPLE_PM_BUS
        select SYSCON
        select MFD_SYSCON
```

## drivers/soc/kendryte/Kconfig
```kconfig
# SPDX-License-Identifier: GPL-2.0

config SOC_K210
	bool "Kendryte K210 SoC drivers"
	depends on RISCV && SOC_KENDRYTE && OF
        select PM
        select SIMPLE_PM_BUS
        select SYSCON
        select MFD_SYSCON
```
